## conf/layer.conf
```bitbake
# We have a conf and classes directory, add to BBPATH
BBPATH .= ":${LAYERDIR}"

# We have recipes-* directories, add to BBFILES
BBFILES += "${LAYERDIR}/recipes-*/*/*.bb \
	${LAYERDIR}/recipes-*/*/*.bbappend"

BBFILE_COLLECTIONS += "ntl-saturn"
BBFILE_PATTERN_ntl-saturn = "^${LAYERDIR}/"
BBFILE_PRIORITY_ntl-saturn = "6"
LAYERVERSION_ntl-saturn = "1"

LAYERDEPENDS_ntl-saturn = "core fsl-arm"
```

## conf/machine/ntl-saturn.conf
```bitbake
#@TYPE: Machine
#@NAME: ntl-saturn

#@DESCRIPTION: Machine configuration for ntl-saturn systems


#MACHINE_EXTRA_RRECOMMENDS = " kernel-modules kernel-devicetree"

#EXTRA_IMAGEDEPENDS += "u-boot"

require conf/machine/include/tune-cortexa9.inc
require conf/machine/include/imx-base.inc

SOC_FAMILY = "mx6:mx6q"

IMAGE_FSTYPES += "tar.bz2"
#EXTRA_IMAGECMD_jffs2 = "-lnp "


#PREFERRED_PROVIDER_virtual/kernel   ?= "linux-yocto-custom"
PREFERRED_PROVIDER_u-boot             = "u-boot-fslc"
PREFERRED_PROVIDER_virtual/bootloader = "u-boot-fslc"
PREFERRED_PROVIDER_virtual/kernel     = "linux-fslc"

#u-boot configs
#SPL_BINARY        = "MLO"
#UBOOT_SUFFIX      = "img"
#UBOOT_MAKE_TARGET = ""
UBOOT_MACHINE     = "wandboard_quad_saturn_defconfig"
#UBOOT_CONFIG      = "sd"
#UBOOT_CONFIG[sd]  = "wandboard_quad_saturn_defconfig"
UBOOT_ENTRYPOINT  = "0x10008000"
UBOOT_LOADADDRESS = "0x12000000"
SERIAL_CONSOLE = "115200 ttymxc0"

#linux kernel configs
KERNEL_IMAGETYPE = "zImage"
#KERNEL_DEVICETREE = "am335x-bone.dtb am335x-boneblack.dtb"
KERNEL_EXTRA_ARGS += "LOADADDR=${UBOOT_ENTRYPOINT}"

#MACHINE_FEATURES  = "usbgadget usbhost vfat alsa"

#IMAGE_BOOT_FILES ?= "u-boot.${UBOOT_SUFFIX} MLO"
#IMAGE_BOOT_FILES ?= "u-boot.${UBOOT_SUFFIX}"
```
